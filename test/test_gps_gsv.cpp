// test_gps_gsv.cpp - satellites IN VIEW, parsed from GSV.
//
// This module exists because the health classifier was branching on GGA field 7
// ("Satellites used"), which is ~0 whenever there is no fix, so it could not
// tell "nothing in the sky" from "plenty in view, still collecting data". The
// 2026-09-02 log caught the consequence: 7.5 minutes of "Needs open sky" during
// an acquisition that was visibly progressing, which then locked at 11m17s.
//
// So the cases that matter here are the ones that would silently mis-count and
// send the next investigation the wrong way:
//   - a satellite reported on two signals must count ONCE, not twice
//   - the same satellite id under two talkers must count TWICE (different birds)
//   - a blank C/N0 means in view but not tracked, and must NOT be dropped
//   - a corrupted sentence must not invent a satellite
//   - satellites must expire, or a powered-down radio keeps a stale sky
//
// Real sentence shapes, taken from u-blox NMEA 4.11 output.

#include "wl_test.h"
#include "gps_gsv.h"
#include <string.h>
#include <stdio.h>

// Feed a whole sentence including the leading '$'. Appends CRLF, which is what
// terminates a sentence on the wire.
static void feed(GpsGsv &g, const char *sentence, uint32_t now_ms)
{
    for (const char *p = sentence; *p; p++) g.feed(*p, now_ms);
    g.feed('\r', now_ms);
    g.feed('\n', now_ms);
}

// Compute and append the correct "*HH" for a body given WITHOUT '$' and
// without the checksum, so the tests below can state intent instead of
// hand-maintaining hex. Returns a pointer to a static buffer.
static const char *with_csum(const char *body)
{
    static char out[128];
    uint8_t sum = 0;
    for (const char *p = body; *p; p++) sum ^= (uint8_t)*p;
    static const char *hex = "0123456789ABCDEF";
    size_t n = strlen(body);
    out[0] = '$';
    memcpy(out + 1, body, n);
    out[1 + n]     = '*';
    out[1 + n + 1] = hex[(sum >> 4) & 0xF];
    out[1 + n + 2] = hex[sum & 0xF];
    out[1 + n + 3] = '\0';
    return out;
}

WL_TEST(gsv_checksum_accepts_a_real_sentence)
{
    // Verbatim capture, checksum included, so the checker is validated against
    // something not generated by our own helper.
    const char *body = "GPGSV,3,1,11,03,03,111,00,04,15,270,00,06,01,010,00,13,06,292,00*74";
    WL_CHECK(gps_gsv_checksum_ok(body, strlen(body)));
}

WL_TEST(gsv_checksum_rejects_corruption)
{
    char body[128];
    strcpy(body, "GPGSV,3,1,11,03,03,111,00,04,15,270,00,06,01,010,00,13,06,292,00*74");
    WL_CHECK(gps_gsv_checksum_ok(body, strlen(body)));

    // Flip one payload digit: same length, same shape, wrong checksum.
    body[13] = '9';
    WL_CHECK(!gps_gsv_checksum_ok(body, strlen(body)));

    // Structural rejections: no checksum, truncated checksum, non-hex digits,
    // empty body, and a NULL.
    WL_CHECK(!gps_gsv_checksum_ok("GPGSV,3,1,11", 12));
    WL_CHECK(!gps_gsv_checksum_ok("GPGSV,3,1,11*7", 14));
    WL_CHECK(!gps_gsv_checksum_ok("GPGSV,3,1,11*ZZ", 15));
    WL_CHECK(!gps_gsv_checksum_ok("*74", 3));
    WL_CHECK(!gps_gsv_checksum_ok(NULL, 10));
}

WL_TEST(gsv_counts_satellites_in_view)
{
    GpsGsv g;
    // Four satellites, all tracked at usable strength.
    feed(g, with_csum("GPGSV,1,1,04,03,03,111,31,04,15,270,34,06,01,010,28,13,06,292,41"), 1000);
    WL_CHECK(g.in_view(1000) == 4);
    WL_CHECK(g.cno_max(1000) == 41);
    WL_CHECK(g.cno_at_least(1000, 30) == 3);   // 31, 34, 41
    WL_CHECK(g.cno_at_least(1000, 42) == 0);
    WL_CHECK(g.overflowed() == 0);
}

WL_TEST(gsv_blank_cno_is_in_view_but_not_tracked)
{
    GpsGsv g;
    // This is the indoor shape: the receiver lists what it believes is overhead
    // from the almanac, with no signal on any of it. Dropping these would erase
    // exactly the evidence that distinguishes a blocked sky from an empty one.
    feed(g, with_csum("GPGSV,1,1,03,03,03,111,,04,15,270,,06,01,010,"), 1000);
    WL_CHECK(g.in_view(1000) == 3);
    WL_CHECK(g.cno_max(1000) == 0);
    WL_CHECK(g.cno_at_least(1000, 1) == 0);
}

WL_TEST(gsv_multi_message_set_accumulates)
{
    GpsGsv g;
    // 11 in view delivered across three messages, the normal case.
    feed(g, with_csum("GPGSV,3,1,11,03,03,111,31,04,15,270,34,06,01,010,28,13,06,292,41"), 1000);
    feed(g, with_csum("GPGSV,3,2,11,14,25,170,33,16,57,208,39,18,42,079,35,22,10,301,22"), 1000);
    feed(g, with_csum("GPGSV,3,3,11,23,72,138,44,26,31,047,30,31,18,225,26"), 1000);
    WL_CHECK(g.in_view(1000) == 11);
    WL_CHECK(g.cno_max(1000) == 44);
}

WL_TEST(gsv_same_satellite_on_two_signals_counts_once)
{
    GpsGsv g;
    // NMEA 4.11 can report one satellite on L1 and again on L5, distinguished
    // only by the trailing signalId. Summing the in-view FIELDS would double
    // count; keying on (talker, svid) cannot.
    feed(g, with_csum("GPGSV,1,1,02,03,03,111,31,04,15,270,34,1"), 1000);
    feed(g, with_csum("GPGSV,1,1,02,03,03,111,29,04,15,270,30,7"), 1000);
    WL_CHECK(g.in_view(1000) == 2);
    // The LATEST reading wins, not the best one: a decaying signal is the thing
    // worth seeing.
    WL_CHECK(g.cno_max(1000) == 30);
}

WL_TEST(gsv_same_id_under_different_talkers_counts_twice)
{
    GpsGsv g;
    // Satellite numbering restarts per constellation, so GPS 03 and Galileo 03
    // are different birds. Keying on svid alone would merge them and undercount
    // a multi-constellation sky.
    feed(g, with_csum("GPGSV,1,1,01,03,03,111,31"), 1000);
    feed(g, with_csum("GAGSV,1,1,01,03,44,201,38"), 1000);
    feed(g, with_csum("GLGSV,1,1,01,03,20,090,27"), 1000);
    WL_CHECK(g.in_view(1000) == 3);
    WL_CHECK(g.cno_max(1000) == 38);
}

WL_TEST(gsv_trailing_signal_id_does_not_invent_a_satellite)
{
    GpsGsv g;
    // The signalId field sits where a 5th satellite's id would go. Recording
    // only on a COMPLETE quad is what keeps it from becoming a phantom.
    feed(g, with_csum("GPGSV,1,1,01,03,03,111,31,1"), 1000);
    WL_CHECK(g.in_view(1000) == 1);
}

WL_TEST(gsv_ignores_non_gsv_and_bad_checksums)
{
    GpsGsv g;
    // GGA and RMC must not contribute, whatever they contain.
    feed(g, with_csum("GPGGA,123519,4807.038,N,01131.000,E,1,08,0.9,545.4,M,46.9,M,,"), 1000);
    feed(g, with_csum("GPRMC,123519,A,4807.038,N,01131.000,E,022.4,084.4,230394,003.1,W"), 1000);
    WL_CHECK(g.in_view(1000) == 0);

    // A GSV whose checksum does not match must not inject satellites: this
    // parser keeps its own state, so a UART overrun that TinyGPSPlus rejects
    // has to be rejected here too.
    feed(g, "$GPGSV,1,1,04,03,03,111,31,04,15,270,34*00", 1000);
    WL_CHECK(g.in_view(1000) == 0);
}

WL_TEST(gsv_satellites_expire)
{
    GpsGsv g;
    feed(g, with_csum("GPGSV,1,1,02,03,03,111,31,04,15,270,34"), 1000);
    WL_CHECK(g.in_view(1000) == 2);

    // Still in view just inside the TTL, gone just outside it. Without this a
    // radio powered down, or a receiver gone quiet, would keep reporting a sky
    // that is no longer being observed.
    WL_CHECK(g.in_view(1000 + kGpsGsvTtlMs - 1) == 2);
    WL_CHECK(g.in_view(1000 + kGpsGsvTtlMs) == 0);
    WL_CHECK(g.cno_max(1000 + kGpsGsvTtlMs) == 0);

    // A refresh extends the entry rather than adding a second one.
    feed(g, with_csum("GPGSV,1,1,01,03,03,111,20"), 1000 + kGpsGsvTtlMs);
    WL_CHECK(g.in_view(1000 + kGpsGsvTtlMs) == 1);
    WL_CHECK(g.cno_max(1000 + kGpsGsvTtlMs) == 20);
}

WL_TEST(gsv_reset_clears_the_sky)
{
    GpsGsv g;
    feed(g, with_csum("GPGSV,1,1,02,03,03,111,31,04,15,270,34"), 1000);
    WL_CHECK(g.in_view(1000) == 2);
    g.reset();
    WL_CHECK(g.in_view(1000) == 0);
    WL_CHECK(g.cno_max(1000) == 0);
    WL_CHECK(g.overflowed() == 0);
}

WL_TEST(gsv_resyncs_on_a_truncated_sentence)
{
    GpsGsv g;
    // A sentence cut off mid-flight (the RX ring overran) must not poison the
    // next one. '$' always restarts the assembler.
    for (const char *p = "$GPGSV,1,1,04,03,03,1"; *p; p++) g.feed(*p, 1000);
    feed(g, with_csum("GPGSV,1,1,01,07,45,123,36"), 1000);
    WL_CHECK(g.in_view(1000) == 1);
    WL_CHECK(g.cno_max(1000) == 36);
}

WL_TEST(gsv_survives_garbage_and_overlong_input)
{
    GpsGsv g;
    // Pre-roll bytes before the first '$' (a mid-sentence power-on).
    for (const char *p = "270,00,06,01,010,00*74\r\n"; *p; p++) g.feed(*p, 1000);
    WL_CHECK(g.in_view(1000) == 0);

    // Longer than any legal NMEA sentence: dropped, not truncated, because a
    // truncation would corrupt the final field and could still parse.
    g.feed('$', 1000);
    for (size_t i = 0; i < kGpsGsvBufBytes + 50; i++) g.feed('A', 1000);
    g.feed('\n', 1000);
    WL_CHECK(g.in_view(1000) == 0);

    // And it still works afterwards.
    feed(g, with_csum("GPGSV,1,1,01,07,45,123,36"), 1000);
    WL_CHECK(g.in_view(1000) == 1);
}

WL_TEST(gsv_table_saturates_without_wrapping)
{
    GpsGsv g;
    // Push more distinct satellites than the table holds, all live, and check
    // the count saturates at capacity while the drops are COUNTED. A silent
    // wrap here would misreport the sky rather than admit it ran out of room.
    const uint8_t cap = g.capacity();
    for (uint16_t i = 1; i <= (uint16_t)cap + 10; i++) {
        char body[64];
        // One satellite per sentence, ids 1..cap+10, all at a usable signal.
        snprintf(body, sizeof(body), "GPGSV,1,1,01,%02u,03,111,31", (unsigned)i);
        feed(g, with_csum(body), 1000);
    }
    WL_CHECK(g.in_view(1000) == cap);
    WL_CHECK(g.overflowed() == 10);

    // Once the old entries expire, a fresh satellite reclaims a slot instead of
    // wedging at capacity forever.
    const uint32_t later = 1000 + kGpsGsvTtlMs;
    WL_CHECK(g.in_view(later) == 0);
    feed(g, with_csum("GPGSV,1,1,01,07,45,123,36"), later);
    WL_CHECK(g.in_view(later) == 1);
    WL_CHECK(g.overflowed() == 10);   // unchanged: no new drop
}

WL_TEST(gsv_millis_rollover_does_not_resurrect_or_kill)
{
    GpsGsv g;
    // millis() wraps at 2^32. The liveness test uses unsigned subtraction, so a
    // satellite seen just before the wrap must stay live just after it.
    const uint32_t before = 0xFFFFFFFFu - 100u;
    feed(g, with_csum("GPGSV,1,1,01,03,03,111,31"), before);
    WL_CHECK(g.in_view(before) == 1);
    WL_CHECK(g.in_view(before + 100u) == 1);           // wrapped to 0xFFFFFFFF
    WL_CHECK(g.in_view(before + 200u) == 1);           // wrapped past zero
    WL_CHECK(g.in_view(before + kGpsGsvTtlMs) == 0);   // and still expires
}
